## Kconfig
```kconfig
menu "ZaruBall Local Features"

config ZMK_SCROLL_STEPPER_PROCESSOR
    bool "Enable ZaruBall scroll stepper input processor"
    default y
    depends on ZMK_POINTING
    help
      Converts scroll events into fixed one-step wheel ticks so scroll speed
      depends on traveled distance rather than large per-event deltas.

endmenu
```

## boards/shields/ZaruBall/Kconfig.defconfig
```kconfig
if SHIELD_ZARUBALL_RIGHT #ここを変えてセントラル側に問題のコードを移行

# Name must be less than 16 characters long!
config ZMK_KEYBOARD_NAME
    default "ZaruBall"

config ZMK_SPLIT_ROLE_CENTRAL
    default y

endif

if SHIELD_ZARUBALL_LEFT || SHIELD_ZARUBALL_RIGHT

config ZMK_SPLIT
    default y

endif

if SHIELD_ZARUBALL_LEFT

endif

# Input Device(pmw3610)のためのコンフィグ
if SHIELD_ZARUBALL_RIGHT

# Other settings

config INPUT
    default y

config ZMK_POINTING
    default y

# Assuming pointing device uses SPI
config SPI
    default y

config ZMK_SPLIT_BLE_CENTRAL_BATTERY_LEVEL_FETCHING
    default y

config ZMK_SPLIT_BLE_CENTRAL_BATTERY_LEVEL_PROXY
    default y

endif
```

## dts/bindings/input_processors/zmk,input-processor-stepper.yaml
```yaml
# Copyright (c) 2026
# SPDX-License-Identifier: MIT

description: Input Processor for converting relative input values into fixed steps

compatible: "zmk,input-processor-stepper"

include: ip_zero_param.yaml

properties:
  type:
    type: int
    required: true
  codes:
    type: array
    required: true
  step-value:
    type: int
    default: 1
    description: Absolute value to emit for any non-zero matching event.
```

## dts/bindings/input_processors/zmk,input-processor-trackball-accel.yaml
```yaml
# Copyright (c) 2026
# SPDX-License-Identifier: MIT

description: Dynamic acceleration for relative pointer events

compatible: "zmk,input-processor-trackball-accel"

include: ip_zero_param.yaml

properties:
  type:
    type: int
    required: true
  codes:
    type: array
    required: true
  base-scale:
    type: int
    default: 1000
    description: Base scale in permille. 1000 means 1.0x.
  max-scale:
    type: int
    default: 2200
    description: Maximum scale in permille once acceleration saturates.
  acceleration-threshold:
    type: int
    default: 150
    description: Smoothed counts per second where acceleration starts.
  acceleration-cap:
    type: int
    default: 1400
    description: Smoothed counts per second where max-scale is reached.
  reset-ms:
    type: int
    default: 40
    description: Idle timeout before velocity history is reset.
  smoothing-percent:
    type: int
    default: 35
    description: Weight of the latest sample in the smoothed speed estimate.
```
